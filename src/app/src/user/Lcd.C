/********************************************************************
//版权说明	:Shenzhen E-EYE Co. Ltd., Copyright 2009- All Rights Reserved.
//文件名称	:Lcd.c		
//功能		:液晶显示
//版本号	:
//开发人	:dxl
//开发时间	:2010.11
//修改者	:
//修改时间	:
//修改简要说明	: 
//备注		:
***********************************************************************/

#include "include.h"

#define USE_BIG_NUMBER 

//警告
const u8 c_apucWarnInformation[][17]	= 
{
{"  速 度 正 常   "},//未报警
{"     !!!        "},//0紧急报警
{" 警告：超速驾驶 "},//1       
{"  超 时 驾 驶   "},//2   
{"  危 险 预 警   "},//3
{"  GNSS模块故障  "},//4    
{"  GNSS天线断开  "},//5
{"  GNSS天线短路  "},//6
{"  主电源欠压    "},//7
{"  主电源掉电    "},//8
{" 外接显示屏故障 "},//9
{"   TTS故障      "},//10
{"  摄像头故障    "},//11
{"  IC卡模块故障  "},//12
{"   超速预警     "},//13
{"  超时驾驶预警  "},//14
{"   保留15       "},//15
{"   保留16       "},//16
{"   保留17       "},//17
{"  累计驾驶超时  "},//18
{"   超时停车     "},//19
{"   进出区域     "},//20
{"   进出路线     "},//21
{"  行驶时间不足  "},//22
{"  路线偏离报警  "},//23
{"  VSS连接异常   "},//24
{"  车辆油量异常  "},//25
{"   车辆被盗     "},//26
{"  车辆非法点火  "},//27
{"  车辆非法位移  "},//28
{"   碰撞预警     "},//29
{"   侧翻预警     "},//30
{"  非法开门报警  "},//31
{""},
};


const u8 c_apucSpecialShowText[ ][17]=
{
    {"系统测试中....   "},	//0
    {"系统测试OK！     "},	//1
    {"FRAM  测试失败!  "},	//2
    {"FLASH 测试失败!  "},	//3
    {"设备未初始化!    "},	//4
    {"时钟测试失败!    "},	//5
    {"EEPROM测试失败!  "}  //6
};
const u8 c_apucSystemFaultType[][17] = 
{
    {" Hard Fault!     "},//硬件错误
    {" Mem Fault!      "},//存储器错误
    {" Bus Fault!      "},//总线错误
    {" Usage Fault!    "},//使用错误
    {" NMI Fault!      "},//不可屏蔽中断
};
const u8 c_apucRegisterInfo[][17] = 
{
    {"注册成功！       "},//0
    {"车辆已被注册！   "},//1
    {"数据库无该车辆！ "},//2
    {"终端已被注册！   "},//3
    {"数据库无该终端！ "},//4
    {"鉴权码长度超出！ "},//5
    {"鉴权成功！       "},//6
    {"鉴权失败！       "},//7
};



//GPRS连接图标
const u8 c_apucGprsIcon[4][32] =
{
    0x00,0x00,0x00,0x00,0x00,0x00,0x00,0x00,
    0x00,0x00,0x00,0x00,0x00,0x00,0x00,0x00,
    0x00,0x00,0x00,0x00,0x00,0x00,0x00,0x00,
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    0x30,0x30,0x30,0x78,0x7F,0x7F,0x78,0x00,//连接1、2
/*
    0x00,0x00,0x3C,0xFC,0xFC,0x3C,0x18,0x18,
    0x18,0x18,0x18,0xF8,0xF8,0x00,0x00,0x00,
    0x00,0x00,0x00,0x1F,0x1F,0x18,0x18,0x18,
    0x18,0x18,0x3C,0x3F,0x3F,0x3C,0x00,0x00//1,有连接
*/
};
//GPS定位图标
const u8 c_apucGpsIcon[2][32] =
{
    0xC0,0x30,0x08,0x04,0x02,0x02,0x01,0x81,
    0xC1,0xE1,0x72,0x3A,0x14,0x08,0x30,0xC0,
    0x03,0x0C,0x10,0x28,0x5C,0x4E,0x87,0x83,
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    0x3F,0x37,0x03,0x01,0x03,0x03,0x00,0x00
};
//GPS方向图标
const u8 c_apucGpsDirection[9][32] = {
	0x01,0x03,0x07,0x0d,0x19,0x01,0x01,0x01,
	0x01,0x01,0x01,0x01,0x01,0x01,0x01,0x01,
	0x80,0xc0,0xe0,0xb0,0x98,0x80,0x80,0x80,
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	0x00,0x00,0x00,0x00,0x00,0x00,0x00,0x00,//8 无方向
		
	};

//GPRS信号强度图标
const u8 c_apucGprsSignal[6][32] = {
	0x00,0x00,0x00,0x00,0x00,0x00,0x00,0x00,
	0x00,0x00,0x00,0x00,0x00,0x00,0x00,0x00,
	0x00,0x00,0x00,0x00,0x00,0x00,0x00,0x00,
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	0x3F,0x00,0x3F,0x3F,0x00,0x3F,0x3F,0x00//5,信号最强
};

#ifdef USE_BIG_NUMBER 
const unsigned char c_apucBigNumber[] =
{
    0x00,0x00,0x00,0x00,0x00,0x00,0x00,0x00,
    0x00,0x00,0x00,0x80,0xC0,0xE0,0xF0,0xF0,
    0xF8,0xF8,0x78,0x3C,0x1C,0x1C,0x0C,0x0C,
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    0x00,0x00,0x00,0x00,0x00,0x00,0x00,0x00,/*"9",9*/
};

const unsigned char c_apucMiddleNumber[] =
{
    
    0x00,0x00,0x00,0x00,0x80,0xC0,0xC0,0xC0,
    0xC0,0xC0,0xC0,0x80,0x00,0x00,0x00,0x00,
    0x00,0xF0,0xFE,0xFF,0x0F,0x01,0x00,0x00,
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    0x06,0x07,0x03,0x03,0x01,0x00,0x00,0x00,/*"9",0*/
};
const unsigned char c_apucPoint[] =
{

    0x00,0x00,0x00,0x00,0x00,0x00,0x00,0x00,
    0x00,0x00,0x00,0x00,0x00,0x00,0x00,0x00,
    0x00,0x00,0x00,0x00,0x00,0x00,0x00,0x00,
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    0x00,0x00,0x00,0x00,0x00,0x00,0x00,0x00,/*".",0*/
};
const unsigned char c_apucDun[] =
{
    0x00,0x00,0xE0,0x20,0x20,0x20,0xE0,0xE0,
    0x00,0x40,0x40,0x40,0x40,0x40,0xFC,0xFC,
    0x40,0x40,0x40,0x40,0x20,0x20,0x00,0x00,
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    0x20,0x20,0x20,0x20,0x20,0x3E,0x00,0x00,/*"吨",0*/
};
const unsigned char c_speedunit[] =
{
    0x00,0x40,0x40,0xC0,0xE0,0x00,0x00,0x00,
    0x00,0x00,0x00,0x00,0x00,0x00,0x00,0x00,
    0x00,0x00,0x00,0xFF,0xFF,0x00,0x00,0x00,
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    0x00,0x00,0x04,0x04,0x07,0x07,0x04,0x04,/*"h",0*/
};
#endif


//主界面显示结构体
typedef struct
{
    unsigned long preAlarmStatus;   //
    unsigned long DriverID;         //驾驶员代码
    unsigned short GpsAzimuth;      //GPS航向     
    unsigned char Speed;            //速度    
    unsigned char GsmRssi;          //GSm信号强度
    unsigned char GprsOnLine;       //GPRS在线标志
    unsigned char GpsStatus;        //GPS定位状态
    unsigned char redrawFlag;       //主界面显示控制变量,1为全刷新,0为只刷新经常变化的量
    unsigned char displayCtrlFlag;  //显示控制标志,1时不显示菜单及主界面,0时进入正常显示
    unsigned char showBigCnt;       //大字显示计数器
    unsigned char showBigData[3];   //大字内容
    unsigned char alarmindex;       //警示内容
    TIME_T Time;                    //系统北京时间
}STLCD_ATTRIB; 
//******************本地变量*******************

static STLCD_ATTRIB s_stLcdAttrib;
u8	LcdOnOffFlag = 0;//LCD屏亮和灭的标志,0为灭,1为亮
////////////////////////////////////////
const unsigned char c_ucShowBigX[4]={0,77,95,110};//大字显示计数器



//////////////////////////////
//************全局变量**********************
//*************外部变量******************
//extern u8 BeepOnEv;
extern TIME_TASK MyTimerTask[];
extern u8	SpeedFlag;//速度类型,dxl,2015.5.11,0x00:手动脉冲,0x01:手动GPS,0x02:自动脉冲,0x03:自动GPS

extern u16     DelayAckCommand;//延时应答命令

/*********************************************************************
//函数名称	:Lcd_ShowText_EvTask(void)
//功能		:LCD显示文本信息（可能很长）
//输入		:信息存放在RadioProtocolDownLoadMsg缓冲里,
//		    :长度为RadioProtocolDownLoadMsgLen
//输出		:
//使用资源	:
//全局变量	:   
//调用函数	:
//中断资源	:  
//返回		:
//备注		:每次显示64个字节
*********************************************************************/
void Lcd_ShowText_EvTask(void)
{
    if(0 ==CommonShareBufferLen)
    {
        Lcd_SetMainRedrawFlag();//刷新整个主界面
        Lcd_ClearDisplayCtrlFlag();
    }
    else
    {
        BEEP_ON();
        OpenLcdBackLight();
        ShowTextForMsgBusyFlag(0); 
        if(CommonShareBufferLen>1023)CommonShareBufferLen =1023;
        memcpy(GB2312Buffer,RadioShareBuffer,CommonShareBufferLen);
        GB2312Buffer[CommonShareBufferLen]=0;
        SystemAutoShowText(CommonShareBufferLen,GB2312Buffer);
    }
}

/*************************************************************
** 函数名称: GetAllCurrentIOINstatus
** 功能描述: 
** 入口参数: 无
** 出口参数: 无
** 返回参数: 无
** 全局变量: 
** 调用模块: 
*************************************************************/	
void Lcd_ShowGpsStatus(void)
{
    //刷新定位标志
    if(s_stLcdAttrib.GpsStatus > 1)
    {
        s_stLcdAttrib.GpsStatus = 1;
    }
    LcdShowPic(32,0,16,16,c_apucGpsIcon[s_stLcdAttrib.GpsStatus]);
}
/*************************************************************
** 函数名称: GetAllCurrentIOINstatus
** 功能描述: 
** 入口参数: 无
** 出口参数: 无
** 返回参数: 无
** 全局变量: 
** 调用模块: 
*************************************************************/	
void Lcd_ShowAzimuth(void)
{
    unsigned char temp1,temp;
    u8	DispBuffer[33];
    //刷新方向
    if(s_stLcdAttrib.Speed < 100)//速度大于100时该位置由速度的百位占用
    {
        if(1 == s_stLcdAttrib.GpsStatus)
        {
            temp = s_stLcdAttrib.GpsAzimuth%45;
            temp1 = s_stLcdAttrib.GpsAzimuth/45;
            if(temp > 23)//向后一级方向靠拢
            {
                temp1++;
            }

            if(temp1>=8)
            {
                temp1 = 0;
            }

        }
        else//没有导航显示空白
        {
            temp1=8;
        }
        ChangeGraphFormatToChineseFormat(DispBuffer, (u8 *)c_apucGpsDirection[temp1]);
        LcdShowPic(48,0,16,16,DispBuffer);
    }
}
/*************************************************************
** 函数名称: GetAllCurrentIOINstatus
** 功能描述: 
** 入口参数: 无
** 出口参数: 无
** 返回参数: 无
** 全局变量: 
** 调用模块: 
*************************************************************/	
void Lcd_ShowGsmRssi(void)
{
    unsigned char temp;
    temp = s_stLcdAttrib.GsmRssi;
    if(temp !=0)//无信号
    {
        temp = s_stLcdAttrib.GsmRssi/6 + 1;
        if(temp > 5)
        {
            temp = 5;//最大信号强度为5级
        }				
    }
    LcdShowPic(0,0,16,16,c_apucGprsSignal[temp]);
    //////////////////
}
/*************************************************************
** 函数名称: GetAllCurrentIOINstatus
** 功能描述: 
** 入口参数: 无
** 出口参数: 无
** 返回参数: 无
** 全局变量: 
** 调用模块: 
*************************************************************/	
void Lcd_ShowGprsOnLine(void)
{
    //刷新无线在线标志
    if(s_stLcdAttrib.GprsOnLine > 3)
    {
        s_stLcdAttrib.GprsOnLine = 3;
    }
    LcdShowPic(16,0,16,16,c_apucGprsIcon[s_stLcdAttrib.GprsOnLine]);
}

/*************************************************************
** 函数名称: Lcd_CheckCurStatus
** 功能描述: 
** 入口参数: 无
** 出口参数: 无
** 返回参数: 无
** 全局变量: 
** 调用模块: 
*************************************************************/	
unsigned char Lcd_CheckAlarmStatus(void)
{
    unsigned long Iostatus,preIostatus;
    static unsigned char sucCnt=0;
    unsigned char i;
    Iostatus=Io_ReadAlarm();    
    preIostatus = s_stLcdAttrib.preAlarmStatus;
    s_stLcdAttrib.preAlarmStatus=Iostatus;
    if(Iostatus != preIostatus)
    {
        sucCnt =0;
        for(i=0; i<32; i++)
        {
            if((0==PUBLIC_CHECKBIT(preIostatus, i))&&PUBLIC_CHECKBIT(Iostatus, i))
            {
                return i+1;
            }
        }
        ///////////////////////////
        for(i=0; i<32; i++)
        {
            if(Io_ReadAlarmBit((ALARM_BIT)i))
            {
                return i+1;
            }
        }
    }
    else
    {
        if(sucCnt<4)
        {
            sucCnt++;
            return s_stLcdAttrib.alarmindex;
        }
        else
        if(sucCnt==4)
        {
            sucCnt = 10;
            for(i=0; i<32; i++)
            {
                if(Io_ReadAlarmBit((ALARM_BIT)i))
                {
                    return i+1;
                }
            }
        }
        else
        {
            return s_stLcdAttrib.alarmindex;
        }
    }
    ///////////////////
    return 0;
}
/*************************************************************
** 函数名称: Lcd_GetContDriveTimeStr
** 功能描述: 
** 入口参数: 无
** 出口参数: 无
** 返回参数: 无
** 全局变量: 
** 调用模块: 
*************************************************************/	
void Lcd_GetContDriveTimeStr(char *DispBuffer,unsigned char flag)
{
    static unsigned char sucPremin=0xff;
    unsigned char min;
    unsigned short tmpVal;
    tmpVal=TiredDrive_GetCurContDriveTime();
    min =tmpVal%60;
    if(flag||sucPremin != min)
    {
        sprintf(DispBuffer,"驾驶:%2d小时%2d分 ",tmpVal/60,min);
        LcdShowStr(0, 16,DispBuffer, 0);
    }
    ///////////////
    sucPremin=min;
}
/*************************************************************
** 函数名称: Lcd_ShowSafetyCaution
** 功能描述: 显示安全警示内容
** 入口参数: 无
** 出口参数: 无
** 返回参数: 无
** 全局变量: 
** 调用模块: 
*************************************************************/	
void Lcd_ShowSafetyCaution(unsigned char reflash)
{
    unsigned char index;
    static unsigned char sucCnt = 0;
    index = Lcd_CheckAlarmStatus();
    if(s_stLcdAttrib.alarmindex != index||reflash)
    {
        s_stLcdAttrib.alarmindex = index; 
        sucCnt =6;//
    }
    ///////////////////
    sucCnt++;    
    if(sucCnt<6)return;//
    sucCnt = 0;
    //////////////////////
    if(0 == index)
    {
        LcdShowStr(0,48,(char *)c_apucWarnInformation[0],0);
    }
    else
    {
        LcdShowStr(0,48,(char *)c_apucWarnInformation[index],1);
    }
}
/*************************************************************
** 函数名称: Lcd_ShowOneHugeNumber
** 功能描述: 显示超大数字 42*48
** 入口参数: x:横坐标,num:0~9
** 出口参数: 无
** 返回参数: 无
** 全局变量: 
** 调用模块: 
*************************************************************/	
void Lcd_ShowOneHugeNumber(unsigned char x,unsigned char value)
{
    #ifdef USE_BIG_NUMBER
    unsigned short index;
    index=value;
    index <<=8;//=*32*8
    DrawPic(x,0,42,48,&c_apucBigNumber[index],0);
    LcdPaintScreen(x,0,x+42,48);
    #endif
}
/*************************************************************
** 函数名称: LCD_showMeddlePoint
** 功能描述: 显示速度单位km/h
** 入口参数: 无
** 出口参数: 无
** 返回参数: 无
** 全局变量: 
** 调用模块: 
*************************************************************/  
void Lcd_dis_SpeedUnit(unsigned char x)
{
#ifdef USE_BIG_NUMBER
   unsigned char i;
   unsigned short index =0;
   for(i=0;i<4;i++)
   {
       index = i<<6;//=*8*8
       DrawPic(x,16,16,32,&c_speedunit[index],0);
       LcdPaintScreen(x,16,x+16,48);
       x+=16;
   }
#endif
}
/*************************************************************
** 函数名称: Lcd_ShowOneMeddleNumber
** 功能描述: 显示超大数字 32*32
** 入口参数: x:横坐标,num:0~9
** 出口参数: 无
** 返回参数: 无
** 全局变量: 
** 调用模块: 
*************************************************************/  
void Lcd_ShowOneMeddleNumber(unsigned char x,unsigned char value,unsigned char mode)
{
    #ifdef USE_BIG_NUMBER
    unsigned short index;
    index=value;
    index <<=6;//=*8*8
    DrawPic(x,16,16,32,&c_apucMiddleNumber[index],mode);
    LcdPaintScreen(x,16,x+16,48);
    #endif
}

/*************************************************************
** 函数名称: Lcd_ShowOneHugeNumber
** 功能描述: 显示超大数字 42*48
** 入口参数: x:横坐标,num:0~9
** 出口参数: 无
** 返回参数: 无
** 全局变量: 
** 调用模块: 
*************************************************************/	
void Lcd_ShowHugeNumber(unsigned char x,unsigned char start,unsigned char max,char *buf)
{
  #ifdef USE_BIG_NUMBER
		unsigned char i;
		unsigned char temp;
		for(i=0; i< max; i++) 	
		{ 	
				temp=buf[start+i]-0x30;
				s_stLcdAttrib.showBigData[i]=temp;
				
				Lcd_ShowOneMeddleNumber(x,temp,0);
				x+=16;
		}
		Lcd_dis_SpeedUnit(x);
		
  #endif
}

/*************************************************************
** 函数名称: Lcd_ShowOnlyBigSpeed
** 功能描述: 
** 入口参数: 无
** 出口参数: 无
** 返回参数: 无
** 全局变量: 
** 调用模块: 
*************************************************************/	
void Lcd_ShowOnlyBigSpeed(void)
{
  #ifdef USE_BIG_NUMBER
		static unsigned char sucLastdatalen;		
		char buf[6];		
		unsigned short index;
		unsigned char temp,len,i,max,x;
		//////////////////
		s_stLcdAttrib.showBigCnt++;
		if(s_stLcdAttrib.showBigCnt==1)//从Lcd_MainInterface界面切换过来
		{
				sprintf(buf,"%d",s_stLcdAttrib.Speed);				
				len=strlen(buf);				
				max=len;
				if(max>3)max=3; 			 
				LcdClearArea(126,16,131,47);
				////////////////////				
				/////////////////////
				x=(126-c_ucShowBigX[max]);
				x>>=1;
				//////////////////
				if(max<3)
				{
						LcdClearArea(0,16,x,47);
						LcdClearArea(x+c_ucShowBigX[max],16,126,47);
				}
				///////////////
				Lcd_ShowHugeNumber(x,len-max,max,buf);
				///////////////////////
				for(i=max; i< 3; i++)
				{
						s_stLcdAttrib.showBigData[i]=0xff;
				}
				sucLastdatalen=max;
				/////////////////
		}
		else
		if(s_stLcdAttrib.showBigCnt>4)//2.0s刷新一次
		{
				//////////////////
				sprintf(buf,"%d",s_stLcdAttrib.Speed);
				len=strlen(buf);
				max=len;
				if(max>3)max=3;
				x=(126-c_ucShowBigX[max]);
				x>>=1;
				//////////////////
				if(sucLastdatalen>max)
				{
						/////////////////////
						index=c_ucShowBigX[sucLastdatalen];
						temp=(126-index);
						temp>>=1;
						LcdClearArea(temp,16,x,47);
						LcdClearArea(x+c_ucShowBigX[max],16,index+temp,47);
						///////////////////
						Lcd_ShowHugeNumber(x,len-max,max,buf);
				}
				else
				if(sucLastdatalen<max)
				{
						Lcd_ShowHugeNumber(x,len-max,max,buf);
				}
				else//if(sucLastdatalen==max)
				{
						for(i=0; i< max; i++) 	
						{ 	
								temp=buf[len+i-max]-0x30;
								/////////////////////
								if(s_stLcdAttrib.showBigData[i]!=temp)//////
								{
										s_stLcdAttrib.showBigData[i]=temp;
										Lcd_ShowOneHugeNumber(x,temp);
								}
								//////////////////////
								x+=42;
						}
				}
				////////////////////////
				for(i=max; i< 3; i++)
				{
						s_stLcdAttrib.showBigData[i]=0xff;
				}
				////////////////////////
				sucLastdatalen = max;
				/////////////////////
				s_stLcdAttrib.showBigCnt = 1;
		}
  #endif
		//////////////////////
}

/*************************************************************
** 函数名称: Lcd_ShowBigNumFlag
** 功能描述: 显示大字
** 入口参数: 无
** 出口参数: 无
** 返回参数: 无
** 全局变量: 
** 调用模块: 
*************************************************************/	
unsigned char Lcd_ShowBigNumFlag(void)
{
    return (s_stLcdAttrib.showBigCnt)?1:0;
}
/*********************************************************************
//函数名称	:Lcd_MainInterface(void)
//功能		:显示主界面
//输入		:
//		:
//输出		:
//使用资源	:
//全局变量	:   
//调用函数	:
//中断资源	:  
//返回		:
//备注		:0.5s调度一次
*********************************************************************/
void Lcd_MainInterface(void)
{    
    static unsigned char sucCnt = 0;//主界面函数进入计数
    char buffer[40];

    s_stLcdAttrib.showBigCnt = 0;
    //获取相关变量
    //GSM信号强度
    s_stLcdAttrib.GsmRssi = communicatio_GetMudulState(SIGN_STRENTH);
    //GPRS在线标志
    s_stLcdAttrib.GprsOnLine = (GetTerminalAuthorizationFlag()>>1);
    //定位状态
    s_stLcdAttrib.GpsStatus = Io_ReadStatusBit(STATUS_BIT_NAVIGATION);
    //航向
    s_stLcdAttrib.GpsAzimuth = Gps_ReadCourse();//顺时针方向旋转
    //当前速度,广州二汽要求脉冲速度不为0时显示脉冲速度，为0时显示GPS速度
    //if(0 == Pulse_GetSpeed())
    //{
       // s_stLcdAttrib.Speed = Gps_ReadSpeed();
    //}
    //else
    //{
        //s_stLcdAttrib.Speed = Pulse_GetSpeed();
    //} 
    if(0 == (SpeedFlag&0x01))//脉冲速度
    {
	  s_stLcdAttrib.Speed = Pulse_GetSpeed();
    }
    else//GPS速度 
    {
	  s_stLcdAttrib.Speed = Gps_ReadSpeed();
    }
    /////////////////////
    RTC_GetCurTime(&s_stLcdAttrib.Time);
    //////////////
    if(s_stLcdAttrib.redrawFlag)//需要全部刷新
    {
        LcdClearScreen();
        s_stLcdAttrib.redrawFlag = 0;
        /////////////////////////
        //第一行,从左到右依次显示无线信号强度,无线连接情况
        //刷新无线信号强度
        Lcd_ShowGsmRssi();
        //刷新无线在线标志
        Lcd_ShowGprsOnLine();
        //刷新定位标志
        Lcd_ShowGpsStatus();
        //刷新方向
        Lcd_ShowAzimuth();
        //刷新速度值
        Lcd_DisplayNumber16(1,48,0,s_stLcdAttrib.Speed);		
        //显示"km/h"
        LcdShowStr(96, 0, "km/h", 0);
        //第二行,显示驾驶时间
        Lcd_GetContDriveTimeStr(buffer,1);
        sucCnt = 0;
        ////////////////
        Public_LcdShowTime(32,s_stLcdAttrib.Time);
        Lcd_ShowSafetyCaution(1);
    }
    else//只刷新经常变化的量
    {
        sucCnt++;        
        //////////////////////
        if(sucCnt>=2)//2s
        {
            sucCnt = 0;
            Lcd_GetContDriveTimeStr(buffer,0);
            //刷新无线信号强度
            Lcd_ShowGsmRssi();
            //刷新无线在线标志
            Lcd_ShowGprsOnLine();
            //刷新定位标志
            Lcd_ShowGpsStatus();            
            ////////////////////////
            Public_LcdShowTime(32,s_stLcdAttrib.Time);
        }
        else
        {
            sprintf(buffer,"%02d:%02d:%02d",s_stLcdAttrib.Time.hour,s_stLcdAttrib.Time.min,s_stLcdAttrib.Time.sec);
            LcdShowStr(67,32,buffer,0);
        }
        //刷新方向
        Lcd_ShowAzimuth();
        ///////////////////
        //刷新速度值
        Lcd_DisplayNumber16(1,48,0,s_stLcdAttrib.Speed);
        ///////////////////
        Lcd_ShowSafetyCaution(0);
    }
}

/*********************************************************************
//函数名称  :Lcd_MainInterface(void)
//功能      :显示主界面
//输入      :
//      :
//输出      :
//使用资源  :
//全局变量  :   
//调用函数  :
//中断资源  :  
//返回      :
//备注      :0.5s调度一次
*********************************************************************/
void Lcd_UpdateCurStatusInfo(void)
{
    s_stLcdAttrib.showBigCnt = 0;
    //获取相关变量
    //GSM信号强度
    s_stLcdAttrib.GsmRssi = communicatio_GetMudulState(SIGN_STRENTH);
    //GPRS在线标志
    s_stLcdAttrib.GprsOnLine = (GetTerminalAuthorizationFlag()>>1);
    //定位状态
    s_stLcdAttrib.GpsStatus = Io_ReadStatusBit(STATUS_BIT_NAVIGATION);
    //航向
    s_stLcdAttrib.GpsAzimuth = Gps_ReadCourse();//顺时针方向旋转
    //当前速度
		s_stLcdAttrib.Speed=SpeedMonitor_GetCurSpeed();
        
    /////////////////////
    RTC_GetCurTime(&s_stLcdAttrib.Time);
}

/*********************************************************************
//函数名称  :LCD_SpeedInterface(void)
//功能      :显示主界面
//输入      :
//      :
//输出      :
//使用资源  :
//全局变量  :   
//调用函数  :
//中断资源  :  
//返回      :
//备注      :0.5s调度一次
*********************************************************************/
void LCD_SpeedInterface(void)
{    
    static unsigned char sucCnt = 0;//主界面函数进入计数

    Lcd_UpdateCurStatusInfo();
    //////////////
    if(s_stLcdAttrib.redrawFlag)//需要全部刷新
    {
        LcdClearScreen();
        s_stLcdAttrib.redrawFlag = 0;
        /////////////////////////
        //第一行,从左到右依次显示无线信号强度,无线连接情况
        //刷新无线信号强度
        Lcd_ShowGsmRssi();
        //刷新无线在线标志
        Lcd_ShowGprsOnLine();
        //刷新定位标志
        Lcd_ShowGpsStatus();
        //刷新方向
        Lcd_ShowAzimuth();
        //刷新速度值
        Lcd_DisplayNumber16(1,48,0,s_stLcdAttrib.Speed);        
        //显示"km/h"
        LcdShowStr(96, 0, "km/h", 0);
        //第二行,显示驾驶时间
     //   Lcd_GetContDriveTimeStr(buffer,1);
        sucCnt = 0;
        ////////////////
        Lcd_ShowOnlyBigSpeed();
        Lcd_ShowSafetyCaution(1);
    }
    else//只刷新经常变化的量
    {
        sucCnt++;        
        //////////////////////
        if(sucCnt>=2)//2s
        {
            sucCnt = 0;
           // Lcd_GetContDriveTimeStr(buffer,0);
            //刷新无线信号强度
            Lcd_ShowGsmRssi();
            //刷新无线在线标志
            Lcd_ShowGprsOnLine();
            //刷新定位标志
            Lcd_ShowGpsStatus();  
            
        }
        //刷新方向
        Lcd_ShowAzimuth();
        ///////////////////
        //刷新速度值
        Lcd_DisplayNumber16(1,48,0,s_stLcdAttrib.Speed);
        ///////////////////
        Lcd_ShowOnlyBigSpeed();
        Lcd_ShowSafetyCaution(0);
    }
}


/*********************************************************************
//函数名称	:Lcd_SetMainRedrawFlag
//功能		:主界面刷新标志
//输入		:
//输出		:
//使用资源	:
//全局变量	:   
//调用函数	:
//中断资源	:  
//返回		:
//备注		:
*********************************************************************/
void Lcd_SetMainRedrawFlag(void)
{
    s_stLcdAttrib.redrawFlag = 1;
}
/*********************************************************************
//函数名称	:Lcd_SetDisplayCtrlFlag
//功能		:设置DisplayControlFlag
//输入		:
//输出		:
//使用资源	:
//全局变量	:   
//调用函数	:
//中断资源	:  
//返回		:
//备注		:
*********************************************************************/
void Lcd_SetDisplayCtrlFlag(void)
{
    s_stLcdAttrib.displayCtrlFlag = 1; 
}
/*********************************************************************
//函数名称	:Lcd_ClearDisplayCtrlFlag(void)
//功能		:清0DisplayControlFlag
//输入		:
//输出		:
//使用资源	:
//全局变量	:   
//调用函数	:
//中断资源	:  
//返回		:
//备注		:
*********************************************************************/
void Lcd_ClearDisplayCtrlFlag(void)
{
    s_stLcdAttrib.displayCtrlFlag = 0;
}

/*********************************************************************
//函数名称	:Lcd_GetDisplayCtrlFlag(void)
//功能		:设置GetDisplayControlFlag
//输入		:
//输出		:
//使用资源	:
//全局变量	:   
//调用函数	:
//中断资源	:  
//返回		:
//备注		:
*********************************************************************/
unsigned char Lcd_GetDisplayCtrlFlag(void)
{
    return (1==s_stLcdAttrib.displayCtrlFlag)?1:0;
}
/*********************************************************************
//函数名称	:Lcd_DisplaySystemTest
//功能		:测试菜单子菜单
//输入		:
//输出		:
//使用资源	:
//全局变量	:   
//调用函数	:
//中断资源	:  
//返回		:
//备注		:
*********************************************************************/
void Lcd_DisplaySystemTest(unsigned char type)
{
    u8    Buffer[100];
    u16   length;
    u8 channel = CHANNEL_DATA_1|CHANNEL_DATA_2;
    ProtocolACK ACK_val;
    static u8 count = 0;
    switch(type)
    {
        case MENU_TEST_REGISTER://终端注册
            ACK_val=RadioProtocol_TerminalRegister(channel);   
            break;
        case MENU_TEST_QUALIFY://终端鉴权
            ACK_val=RadioProtocol_TerminalQualify(CHANNEL_DATA_1);//只能一个一个通道发，因为通道不一样鉴权码也不一样      
            ACK_val=RadioProtocol_TerminalQualify(CHANNEL_DATA_2);
            break;
        #ifdef MENU_TEST_LOGOUT
        case MENU_TEST_LOGOUT://终端注销
            ACK_val= RadioProtocol_TerminalLogout(channel);
            if(ACK_OK ==ACK_val)
            {
                if(MyTimerTask[TIME_DELAY_TRIG].TaskTimerState == DISABLE)
                {
                    u8	i;
                    DelayAckCommand = 0x0003; 
                    //触发延时任务
                    SetTimerTask(TIME_DELAY_TRIG, SECOND);
                    //擦除鉴权码
                    ClearTerminalAuthorizationCode(CHANNEL_DATA_1);
                    ClearTerminalAuthorizationCode(CHANNEL_DATA_2);
                }
            }            
            break;
        #endif
        case MENU_TEST_SEND_POST://位置信息汇报
            Public_GetCurBasicPositionInfo(Buffer);
            length = 28;
            ACK_val=RadioProtocol_PostionInformationReport(channel,Buffer,length); 
            break;
        case MENU_TEST_EVENT_REPORT://事件报告
            ACK_val=RadioProtocol_EvenReport(channel,0x01);            
            break;
        case MENU_TEST_SEND_MESSAGE://信息点播
            ACK_val= RadioProtocol_InforamtionOrder(channel,1, 1);            
            break;
        case MENU_TEST_CANCEL_MESSAGE://信息取消
            ACK_val= RadioProtocol_InforamtionOrder(channel,1, 0);            
            break;
        case MENU_TEST_SEND_E_WAYBILL://电子运单上报
            //电子运单上报
            memcpy(Buffer+4,"电子运单",8);
            Buffer[0] = 0;
            Buffer[1] = 0;
            Buffer[2] = 0;
            Buffer[3] = 8;
            ACK_val= RadioProtocol_ElectricReceiptReport(channel,Buffer, 12);
            break;
        case MENU_TEST_DRIVER_INFO://驾驶员身份信息
            count++;
            length = 0;
            // Buffer[length] = 0x07;
            length++;
            // Buffer[length] = 0x02;
            length++;
            //驾驶员姓名长度
            Buffer[length] = 10;
            length++;
            //驾驶员姓名
            memcpy(Buffer+length,"驾驶员姓名",10);
            length += 10;
            //驾驶证号码
            memcpy(Buffer+length,"驾驶证号码1234567890",20);
            length += 20;
            //从业资格证编码
            memcpy(Buffer+length,"从业资格证编码abcdefghijklmnopqrstuvwxyz",40);
            length += 40;
            //发证机构长度
            Buffer[length] = 8;
            length++;
            //发证机构
            memcpy(Buffer+length,"发证机构",8);
            length += 8;
            //签到签退标志,1为签到,2为签退
            if(2 == count%2+1)
            {
                Buffer[0] = 0x00;
                Buffer[1] = 0x01;
            }
            else
            {
                Buffer[0] = 0x00;
                Buffer[1] = 0x02;
            }
            //当前时间 
            Public_ConvertNowTimeToBCDEx(&Buffer[length]);                      
            length+=6;
            //通过透传指令上传驾驶员信息
            ACK_val=  RadioProtocol_OriginalDataUpTrans(channel,0xe3, Buffer, length);            
            break;
        case MENU_TEST_MULIT_EVENT://上发多媒体事件
            ACK_val=RadioProtocol_MultiMediaEvenReport(channel,0x01, 0, 0, 1, 1);
            break;
        case MENU_TEST_SEND_DTU_DATA://数据上行透传
            ACK_val= RadioProtocol_OriginalDataUpTrans(channel,1, Buffer, 10);
            break;     
				case MENU_TEST_RESUME_FCT://恢复出厂未使用状态
            ACK_val = E2ParamApp_ResumeFactory();
						//重启
			 			NVIC_SystemReset();
            break;   
        default:
            break;
    }
    ///////////////////////////
    if(ACK_OK == ACK_val)
    {
        //显示发送成功
        LcdShowStr(0, 0, "发送成功！ ", 10);
    }
    else
    {
        //显示发送失败
        LcdShowStr(0, 0, "发送失败！ ", 10);
        
    }
}
/*********************************************************************
//函数名称	:Lcd_DisplayJ_1
//功能		:测试菜单子菜单
//输入		:
//输出		:
//使用资源	:
//全局变量	:   
//调用函数	:
//中断资源	:  
//返回		:
//备注		:
*********************************************************************/
void Lcd_SendTerminalLogout(void)
{
    ProtocolACK ACK_val;
     u8 channel = CHANNEL_DATA_1|CHANNEL_DATA_2;

    ACK_val= RadioProtocol_TerminalLogout(channel);
    if(ACK_OK ==ACK_val)
    {
      
        if(MyTimerTask[TIME_DELAY_TRIG].TaskTimerState == DISABLE)
        {
            DelayAckCommand = 0x0003;
            //触发延时任务
            SetTimerTask(TIME_DELAY_TRIG, 10);
            //擦除鉴权码
            ClearTerminalAuthorizationCode(CHANNEL_DATA_1);
            ClearTerminalAuthorizationCode(CHANNEL_DATA_2);
        }
    }
    else
    {
          LcdClearArea(0,19,131,44);
        LcdShowCaption("终端注销失败", 24);
    }
}
/*************************************************************
** 函数名称: Lcd_CheckCurShowFlag
** 功能描述: 
** 入口参数: 无
** 出口参数: 无
** 返回参数: 无
** 全局变量: 
** 调用模块: 
*************************************************************/	
unsigned char Lcd_CheckCurShowFlag(void)
{
    #if 0
    static unsigned char sucRunStateflag=0;
    static unsigned char sucCnt = 0;
    /////////////////////////////
    //当前速度    
    s_stLcdAttrib.Speed = SpeedMonitor_GetCurSpeed();
    ////////////////////
    if(SpeedMonitor_GetCurRunStatus() && (s_stLcdAttrib.Speed > 5))
    {
        if(!sucRunStateflag)
        {
            sucCnt++;
            if(s_stLcdAttrib.Speed>30)sucCnt++;
            if(sucCnt>10)
            {
                sucCnt =0;
                sucRunStateflag =1;
            }
        }
    }
    else
    {
        sucRunStateflag = 0;
        sucCnt = 0;
    }
    return sucRunStateflag;
    #else
    return 0;
    #endif 
}
u8 Lcd_GetSpeed(void)
{
	return s_stLcdAttrib.Speed;
}
/*************************************************************
** 函数名称: Lcd_SetSystemRFEnable
** 功能描述: 
** 入口参数: 无
** 出口参数: 无
** 返回参数: 无
** 全局变量: 
** 调用模块: 
*************************************************************/	
void Lcd_SetSystemRFEnable(void)
{
}
/*********************************************************************
//函数名称	:RFLogin_EvTask(void)
//功能		:刷卡登录
//输入		:
//输出		:
//使用资源	:
//全局变量	:   
//调用函数	:
//中断资源	:  
//返回		:
//备注		:
*********************************************************************/
void RFLogin_EvTask(void)
{
}
/********************************************************************************
 *                            End of Module
 *******************************************************************************/

